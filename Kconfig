## Kconfig
```kconfig
DT_COMPAT_ZMK_LEDSTRIP_STATUS := zmk,ledstrip-status

config LEDSTRIP_STATUS
    bool "Show battery, charging and connection status on an addressable LED strip"
    default $(dt_compat_enabled,$(DT_COMPAT_ZMK_LEDSTRIP_STATUS))
    select LED_STRIP

if LEDSTRIP_STATUS

config LEDSTRIP_STATUS_BRIGHTNESS
    int "Full brightness, 0-255 per channel"
    range 1 255
    default 32
    help
      Cap applied to every color. About 12 % of full scale keeps the current
      low and is plenty behind a light pipe.

config LEDSTRIP_STATUS_HALF_PERCENT
    int "Brightness of a half-lit gauge LED, in percent of full"
    range 1 100
    default 40

config LEDSTRIP_STATUS_DIM_PERCENT
    int "Brightness of inactive profile LEDs, in percent of full"
    range 0 100
    default 15

config LEDSTRIP_STATUS_SHOW_MS
    int "How long the battery gauge and connection status are shown"
    default 3000

config LEDSTRIP_STATUS_SHOW_ON_BOOT
    bool "Show the battery gauge (and connection status) after boot"
    default y

config LEDSTRIP_STATUS_BOOT_DELAY_MS
    int "Wait after boot before the first display, so the battery is sampled"
    default 1000

config LEDSTRIP_STATUS_SHOW_CONN_CHANGES
    bool "Show connection status when the BLE profile or split link changes"
    default y

config LEDSTRIP_STATUS_LINK_BLINK_MS
    int "Peripheral: duration of the connected/disconnected blink"
    default 500

# Battery gauge colors, by state of charge

config LEDSTRIP_STATUS_LEVEL_GREEN
    int "Gauge is green at or above this battery level"
    default 50

config LEDSTRIP_STATUS_LEVEL_YELLOW
    int "Gauge is yellow at or above this battery level"
    default 34

config LEDSTRIP_STATUS_LEVEL_AMBER
    int "Gauge is amber at or above this level; below it the gauge is red and blinks"
    default 17

config LEDSTRIP_STATUS_LEVEL_CRITICAL
    int "Blink the gauge on every battery level change below this level (0 disables)"
    default 10

config LEDSTRIP_STATUS_CRITICAL_SHOW_MS
    int "Duration of the critical battery warning"
    default 1500

config LEDSTRIP_STATUS_SHOW_ON_LEVEL_DROP
    bool "Show the gauge whenever it drops a step (one sixth with 3 LEDs) on battery"

# Persistent indicators: shown whenever no timed display is running

config LEDSTRIP_STATUS_SHOW_LAYER
    bool "Show the highest active layer's color (layer-colors) on one LED"
    default y

config LEDSTRIP_STATUS_SHOW_CAPS_LOCK
    bool "Show caps lock on one LED"
    default y
    imply ZMK_HID_INDICATORS
    imply ZMK_SPLIT_PERIPHERAL_HID_INDICATORS

config LEDSTRIP_STATUS_SHOW_CAPS_WORD
    bool "Show caps word on the caps LED (central)"
    default y

config LEDSTRIP_STATUS_INDICATOR_PERCENT
    int "Brightness of the layer and caps indicators, in percent of full"
    range 1 100
    default 100

config LEDSTRIP_STATUS_INDICATORS_IDLE_OFF
    bool "Hide the layer and caps indicators while idle on battery"
    default y

# Charging

config LEDSTRIP_STATUS_CHARGING_ALWAYS
    bool "Show the charging animation for as long as the battery charges"
    help
      Without this, the animation runs for CHARGING_SHOW_MS after charging
      starts. The board is on USB power meanwhile, so it costs no battery.

config LEDSTRIP_STATUS_CHARGING_SHOW_MS
    int "How long the charging animation runs after charging starts"
    default 5000

config LEDSTRIP_STATUS_CHARGED_SHOW_MS
    int "How long solid green is shown when charging completes"
    default 3000

config LEDSTRIP_STATUS_BREATHE_PERIOD_MS
    int "Period of the charging breathing animation"
    default 2000

# Timing

config LEDSTRIP_STATUS_BLINK_PERIOD_MS
    int "Period of blinking displays"
    default 500

config LEDSTRIP_STATUS_FRAME_MS
    int "Refresh interval while something is shown"
    default 40

config LEDSTRIP_STATUS_GAP_MS
    int "Dark gap between two consecutive displays"
    default 150

config LEDSTRIP_STATUS_THREAD_STACK_SIZE
    int "Stack size of the display thread"
    default 1024

config LEDSTRIP_STATUS_THREAD_PRIORITY
    int "Priority of the display thread"
    default 10

endif # LEDSTRIP_STATUS

DT_COMPAT_ZMK_BEHAVIOR_LEDSTRIP_STATUS := zmk,behavior-ledstrip-status

config ZMK_BEHAVIOR_LEDSTRIP_STATUS
    bool
    default $(dt_compat_enabled,$(DT_COMPAT_ZMK_BEHAVIOR_LEDSTRIP_STATUS))

config LEDSTRIP_STATUS_TEST
    bool "Test doubles for running the module's tests on native_sim"
    depends on ARCH_POSIX
```

## dts/bindings/behaviors/zmk,behavior-ledstrip-status.yaml
```yaml
description: Show battery or connection status on the status LED strip

compatible: "zmk,behavior-ledstrip-status"

include: zero_param.yaml

properties:
  show-battery:
    type: boolean
  show-connection:
    type: boolean
```

## dts/bindings/test/zmk,behavior-ledstrip-status-test.yaml
```yaml
description: Test double for native_sim, drives the fake battery and the emulated charger/VBUS inputs

compatible: "zmk,behavior-ledstrip-status-test"

include: two_param.yaml

properties:
  vbus-gpios:
    type: phandle-array
    required: true
  charge-gpios:
    type: phandle-array
    required: true
```

## dts/bindings/test/zmk,ledstrip-status-test-battery.yaml
```yaml
description: Test double for native_sim, a fuel gauge whose level a test sets

compatible: "zmk,ledstrip-status-test-battery"

properties:
  level:
    type: int
    default: 100
```

## dts/bindings/test/zmk,ledstrip-status-test-strip.yaml
```yaml
description: Test double for native_sim, a led-strip that logs every changed frame

compatible: "zmk,ledstrip-status-test-strip"

properties:
  chain-length:
    type: int
    required: true
  supply-gpios:
    type: phandle-array
    description: The supply enable output to report with each frame (gpio-emul only).
```

## dts/bindings/zmk,ledstrip-status.yaml
```yaml
description: |
  Battery, charging and connection status shown on a short addressable LED
  strip (WS2812 / SK6812), with an optional power switch for the strip.

compatible: "zmk,ledstrip-status"

properties:
  led-strip:
    type: phandle
    required: true
    description: The led-strip device (e.g. worldsemi,ws2812-spi) to drive.

  enable-gpios:
    type: phandle-array
    description: |
      Switches the strip's supply (e.g. the gate of a P-FET high-side switch,
      flagged GPIO_ACTIVE_LOW). Driven active only while something is shown,
      so the LEDs draw nothing when dark.

  charge-gpios:
    type: phandle-array
    description: |
      Charger status input, active while the battery is charging. On the
      XIAO nRF52840 this is the BQ25101 CHG output on P0.17, open drain,
      active low: <&gpio0 17 (GPIO_ACTIVE_LOW | GPIO_PULL_UP)>.

  vbus-gpios:
    type: phandle-array
    description: |
      USB power (VBUS) sense input, active while USB power is present. Without
      it, VBUS is read from the nRF52840 USBREGSTATUS register, or from ZMK's
      USB state on other SoCs.

  led-order:
    type: array
    description: |
      Strip index of each logical LED. Logical LED 0 is where the battery
      gauge starts filling. Defaults to the strip order.

  power-on-delay-ms:
    type: int
    default: 1
    description: Wait after switching the supply on before sending data.
```
