#include "../ledstrip_status.dtsi"

/* 45 % with the Forager right half's reversed chain: the gauge fills from strip LED 2 */
&test_battery {
    level = <45>;
};

&status_leds {
    led-order = <2 1 0>;
};

&kscan {
    events = <TAP(NOP, 5000)>;
};
