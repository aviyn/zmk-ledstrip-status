#include "../ledstrip_status.dtsi"

/*
 * Pressing the battery key again while the gauge is lit restarts its 3 s
 * timeout instead of queueing a second gauge. A different display (charged,
 * from plugging USB into a full battery) waits its turn behind it, after a
 * short dark gap, without the supply going off in between.
 */
&kscan {
    events = <
        TAP(NOP, 4480)
        TAP(SHOW_BAT, 1990)  /* 4.5 s */
        TAP(SHOW_BAT, 90)    /* 6.5 s, now lit until 9.5 s */
        TAP(VBUS_ON, 6990)   /* 6.6 s, charged queued at 7.1 s */
        TAP(NOP, 10)
    >;
};
