#include "../ledstrip_status.dtsi"

/*
 * Sleep while the gauge is lit: the supply is cut at once and no frame
 * follows. A request while asleep is ignored; after waking it works again.
 */
&kscan {
    events = <
        TAP(NOP, 4480)
        TAP(SHOW_BAT, 990)   /* 4.5 s */
        TAP(SLEEP, 990)      /* 5.5 s */
        TAP(SHOW_BAT, 990)   /* 6.5 s, ignored */
        TAP(WAKE, 490)       /* 7.5 s */
        TAP(SHOW_BAT, 3990)  /* 8.0 s */
        TAP(NOP, 10)
    >;
};
